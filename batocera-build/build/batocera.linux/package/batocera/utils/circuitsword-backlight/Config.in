## batocera-build/build/batocera.linux/package/batocera/utils/circuitsword-backlight/Config.in
```kconfig
comment "circuitsword-backlight needs a Linux kernel to be built"
	depends on !BR2_LINUX_KERNEL

config BR2_PACKAGE_CIRCUITSWORD_BACKLIGHT
	bool "circuitsword-backlight"
	depends on BR2_LINUX_KERNEL
	help
	  Virtual backlight class device bridging Batocera's native
	  brightness UI (batocera-brightness, EmulationStation settings) to
	  the Circuit-Sword's Arduino Leonardo, via the rpi-circuitsword.py
	  daemon.
```

## batocera-build/build/batocera.linux/package/batocera/utils/circuitsword-quickmenu/Config.in
```kconfig
config BR2_PACKAGE_CIRCUITSWORD_QUICKMENU
	bool "circuitsword-quickmenu"
	depends on BR2_PACKAGE_WAYLAND
	select BR2_PACKAGE_WAYLAND_PROTOCOLS
	select BR2_PACKAGE_FREETYPE
	help
	  Standalone in-game quick menu (WiFi toggle, volume, brightness)
	  for the Circuit-Sword. Draws a full-screen overlay-layer Wayland
	  surface (wlr-layer-shell-unstable-v1) on top of the running
	  emulator via labwc, and reads the on-board Arduino Leonardo
	  joystick via raw evdev. Launched by the rpi-circuitsword.py
	  daemon on a MODE button press while a game is running.

comment "circuitsword-quickmenu needs wayland"
	depends on !BR2_PACKAGE_WAYLAND
```

## batocera-build/build/batocera.linux/package/batocera/utils/circuitsword-rtk-bluetooth/Config.in
```kconfig
config BR2_PACKAGE_CIRCUITSWORD_RTK_BLUETOOTH
	bool "circuitsword-rtk-bluetooth"
	help
	  rtk_hciattach + firmware for the Circuit-Sword's on-board RTL8723BS
	  Bluetooth (UART-attached, /dev/ttyAMA0). Vendored from the original
	  RetroPie-based Circuit-Sword build -- the proven-working attach
	  tool for this chip; bluez's generic btattach cannot complete the
	  chip's firmware/config download step.
```

## batocera-build/build/batocera.linux/package/batocera/utils/circuitsword-statusbar/Config.in
```kconfig
config BR2_PACKAGE_CIRCUITSWORD_STATUSBAR
	bool "circuitsword-statusbar"
	depends on BR2_PACKAGE_WAYLAND
	select BR2_PACKAGE_WAYLAND_PROTOCOLS
	help
	  Permanent, passive in-game status bar (battery, WiFi, volume)
	  for the Circuit-Sword. Draws a top-anchored
	  overlay-layer Wayland surface (wlr-layer-shell-unstable-v1) on
	  top of the running emulator via labwc, for as long as a game is
	  running. Never grabs input and never pauses the game -- purely
	  passive. Launched and killed by the rpi-circuitsword.py daemon's
	  statusbar_thread as games start/stop.

comment "circuitsword-statusbar needs wayland"
	depends on !BR2_PACKAGE_WAYLAND
```

## package/batocera/utils/circuitsword-battery/Config.in
```kconfig
comment "circuitsword-battery needs a Linux kernel to be built"
	depends on !BR2_LINUX_KERNEL

config BR2_PACKAGE_CIRCUITSWORD_BATTERY
	bool "circuitsword-battery"
	depends on BR2_LINUX_KERNEL
	help
	  Virtual power_supply kernel module feeding EmulationStation's
	  native battery icon from the Circuit-Sword's Arduino Leonardo
	  battery ADC, via the rpi-circuitsword.py daemon.
```
